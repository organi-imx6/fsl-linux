/dts-v1/;

#include "imx6dl.dtsi"
#include "imx6qdl-wisehmi-dev.dtsi"

/ {
	model = "Freescale i.MX6 DualLite/Solo Wise HMI Board";
	compatible = "autorock,imx6dl-wisehmi", "autorock,imx6qdl-wisehmi", "fsl,imx6dl";
};
