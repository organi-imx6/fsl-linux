#include "imx6dl-wisehmi.dts"

&mxcfb1 {
	disp_dev = "ldb";
	mode_str = "CHUNGHWA_CLAA088WA01XN";
	interface_pix_fmt = "RGB24";
};

&ldb {
	status = "okay";
};

&lcd {
	status = "disable";
};

&uart3 {
       status = "okay";
};
